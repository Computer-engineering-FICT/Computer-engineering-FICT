;                     ЛИСТИНГ 3.1
;           Мнемонические обозначения кодов,
;        используемых в процедурах ввода-вывода
;
; Автор текста программы Кулаков Владимир Геннадьевич.
; Файл lst03_01.inc, 30.01.2001.

; КОДЫ УПРАВЛЯЮЩИХ КЛАВИШ
; Для "текстовых" управляющих клавиш вместо скан-кодов
; используются ASCII-коды:
B_RUBOUT equ   8 ;забой
B_TAB    equ   9 ;табуляция
B_LF     equ  10 ;перевод строки
B_ENTER  equ  13 ;возврат каретки
B_ESC    equ  27 ;"Esc"
; Скан-коды функциональных клавиш:
F1       equ  59
F2       equ  60
F3       equ  61
F4       equ  62
F5       equ  63
F6       equ  64
F7       equ  65
F8       equ  66
F9       equ  67
F10      equ  68
; Скан-коды клавиш дополнительной клавиатуры:
B_HOME   equ  71 ;перейти в начало
B_UP     equ  72 ;стрелка вверх
B_PGUP   equ  73 ;на страницу вверх
B_BS     equ  75 ;стрелка влево
B_FWD    equ  77 ;стрелка вправо
B_END    equ  79 ;перейти в конец
B_DN     equ  80 ;стрелка вниз
B_PGDN   equ  81 ;на страницу вниз
B_INS    equ  82 ;переключить режим (вставка/замещение)
B_DEL    equ  83 ;удалить символ над курсором

; МНЕМОНИЧЕСКИЕ ОБОЗНАЧЕНИЯ ЦВЕТОВ
; "Темные" цвета (можно использовать для фона и текста)
BLACK        equ  0 ;черный
BLUE         equ  1 ;темно-синий
GREEN        equ  2 ;темно-зеленый
CYAN         equ  3 ;бирюзовый (циан)
RED          equ  4 ;темно-красный
MAGENTA      equ  5 ;темно-фиолетовый
BROWN        equ  6 ;коричневый
LIGHTGREY    equ  7 ;серый
; "Светлые" цвета (только для текста)
DARKGREY     equ  8 ;темно-серый
LIGHTBLUE    equ  9 ;синий
LIGHTGREEN   equ 10 ;зеленый
LIGHTCYAN    equ 11 ;голубой
LIGHTRED     equ 12 ;красный
LIGHTMAGENTA equ 13 ;фиолетовый
YELLOW       equ 14 ;желтый
WHITE        equ 15 ;белый

